/dts-v1/;
/plugin/;

/ {
    fragment@0 {
        target-path ="/";
        __overlay__ {
            my_device_jerry {
                compatible = "a_second_name";
                lights1-gpios = <&gpio 5 0 >;
		lights2-gpios = <&gpio 6 0 >;
            };
        };
    };

};